#include "config.h"


bit busy;
/******************************************************************************/
// 函数名称：uart1Init 
// 输入参数：无 
// 输出参数：无 
// 函数功能：设置好定时器2的工作模式 
/******************************************************************************/
void Uart1Init(void)//115200bps@11.0592MHz
{
	SCON = 0x50;		//8位数据,可变波特率      0b01010000    SM0 = 0; SM1 = 1; 工作模式:模式1 可变8位数据模式
	AUXR |= 0x01;		//串口1选择定时器2为波特率发生器
	AUXR |= 0x04;		//定时器2时钟为Fosc,即1T
	T2L = 0xE8;			//设定定时初值
	T2H = 0xFF;			//设定定时初值    65536-11059200/115200/4=0FFE8H
	AUXR |= 0x10;		//启动定时器2
	ES = 1;  				//使能串口1中断
//	SBUF = 0x5a;                                //发送测试数据
}
/******************************************************************************/
// 函数名称：uartSendData 
// 输入参数：ucData: 发送字节 
// 输出参数：无 
// 函数功能：使用串口发送一个字节数据 
/******************************************************************************/
void UartSend(uint8 dat)
{
    while (busy);
    busy = 1;
    SBUF = dat;
}
//printf 重映射
char putchar(char dat)
{
	UartSend(dat);
	return dat;
}

/******************************************************************************/
// 函数名称：time0ISR 
// 输入参数：无 
// 输出参数：无 
// 函数功能：串口0服务函数 
/******************************************************************************/
void Uart1Isr() interrupt 4 using 1
{
    if (TI)
    {
        TI = 0;
        busy = 0;
    }
    if (RI)
    {
        RI = 0;
				LED4 = !LED4;
    }
}